## yocto/meta-user/conf/machine/zynq-generic-7z020.conf
```bitbake
#@TYPE: Machine
#@NAME: zynq-generic-7z020
#@DESCRIPTION: Machine configuration for the zynq-generic-7z020 boards.

#### Preamble
MACHINEOVERRIDES =. "${@['', 'zynq-generic-7z020:']['zynq-generic-7z020' !='${MACHINE}']}"
#### Regular settings follow

# Yocto device-tree variables
YAML_CONSOLE_DEVICE_CONFIG:pn-device-tree ?= "ps7_uart_0"
YAML_MAIN_MEMORY_CONFIG:pn-device-tree ?= "ps7_ddr_0"
DT_PADDING_SIZE:pn-device-tree ?= "0x1000"
DTC_FLAGS:pn-device-tree ?= "-@"
YAML_DT_BOARD_FLAGS ?= "{BOARD template}"
KERNEL_DEVICETREE::append = "zynq-zc702.dtb"

# Yocto u-boot-xlnx variables
UBOOT_MACHINE ?= "xilinx_zynq_virt_defconfig"

# Yocto FSBL variables
YAML_SERIAL_CONSOLE_STDIN:pn-fsbl-firmware ?= "ps7_uart_0"
YAML_SERIAL_CONSOLE_STDOUT:pn-fsbl-firmware ?= "ps7_uart_0"

# Serial Console Settings
SERIAL_CONSOLES ?= "115200;ttyPS0"
YAML_SERIAL_CONSOLE_BAUDRATE ?= "115200"

# Set DDR Base address for u-boot-xlnx-scr variables
DDR_BASEADDR ?= "0x0"
SKIP_APPEND_BASEADDR ?= "0"

# Yocto KERNEL Variables
UBOOT_ENTRYPOINT  ?= "0x200000"
UBOOT_LOADADDRESS ?= "0x200000"
KERNEL_EXTRA_ARGS += "UIMAGE_LOADADDR=${UBOOT_ENTRYPOINT}"

# Required generic machine inclusion
require conf/machine/zynq-generic.conf

# This is an 'XSCT' based BSP
XILINX_WITH_ESW = "xsct"

# Add system XSA
HDF_EXT = "xsa"
HDF_BASE = "file://"
HDF_PATH = "${TOPDIR}/../../Vivado/pynq_z1_top.xsa" 


IMAGE_FSTYPES:append = " wic"
IMAGE_FSTYPES:remove = " wic.qemu-sd"
WKS_FILES = "sdimage-zynq.wks"
    
IMAGE_BOOT_FILES = " \
		boot.bin \
		system.dtb \
		boot.scr \
		uImage \
		"
		
INIT_MANAGER ?= "systemd"
INIT_MANAGER_DEFAULT ?= "systemd"
	
PACKAGE_CLASSES ?= "package_ipk" 
PATCHRESOLVE = "noop" 
require conf/distro/include/no-static-libs.inc 
require conf/distro/include/yocto-uninative.inc 
require conf/distro/include/security_flags.inc 
INHERIT:append = " uninative" 
DISTRO_FEATURES:append = " largefile systemd usrmerge" 
VIRTUAL-RUNTIME_init_manager = "systemd" 
LICENSE_FLAGS_ACCEPTED:append = " xilinx"

    
#### No additional settings should be after the Postamble
#### Postamble
PACKAGE_EXTRA_ARCHS:append = "${@['', ' zynq_generic_7z020']['zynq-generic-7z020' != '${MACHINE}']}"
```

## yocto/meta-user/wic/sdimage-zynq.wks
```
part /boot --source bootimg-partition --use-label --fstype=vfat --label boot --active --align 4 --fixed-size 100M
part /     --source rootfs            --use-label --fstype=ext4 --label root          --align 4 --fixed-size 2G
```
